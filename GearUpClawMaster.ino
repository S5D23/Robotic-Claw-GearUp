// ============================================================
// GEAR UP TEAM #31242 - ROBOTIC CLAW MASTER CONTROLLER
// ============================================================
// What this program does:
// This code runs on a tiny computer called an ESP32.
// It lets you control 4 servo motors (the motors that make the robot arm move)
// using a web page on your phone or laptop.
// You connect to the robot's WiFi, open a browser, and slide sliders to move the arm.


// ============================================================
// LIBRARIES - Think of these like apps you "install" to get extra abilities
// ============================================================


// Wire.h gives the ESP32 the ability to talk to other chips using 2 wires.
// One wire carries data (the actual message), one wire keeps timing (like a drumbeat).
// We need this so the ESP32 can send commands to the servo controller chip.
#include <Wire.h>


// Adafruit_PWMServoDriver.h gives us control over a chip called PCA9685.
// The PCA9685 is a small chip that sits between the ESP32 and the servo motors.
// Its job: translate simple commands ("move to 90 degrees") into the exact
// electrical pulses that servo motors need to physically move.
// One PCA9685 chip can control up to 16 servo motors. We only use 4.
#include <Adafruit_PWMServoDriver.h>


// WiFi.h lets the ESP32 create its own WiFi network (like a phone hotspot).
// Without this, the ESP32 can't do anything wireless.
#include <WiFi.h>


// WebServer.h lets the ESP32 act like a tiny website server.
// When you open a browser and type an address, this library handles
// receiving your request and sending a response back.
#include <WebServer.h>


// html.h is our own file that contains the website code (the slider control page).
// When someone opens the control page in a browser, this code is what gets sent to them.
// It's stored here so we don't clutter this main file with website code.
#include "html.h"


// ============================================================
// CREATING THE SERVO CONTROLLER OBJECT
// ============================================================
// This line creates a variable called "pca" that represents the PCA9685 chip.
// Think of it like creating a TV remote in code - once you have it,
// you can press buttons (call functions) to control the servos.
// The "0x40" is the chip's address - like a house number on a street.
// The ESP32 uses this address to know which chip to send commands to.
// (If you had two PCA9685 chips, one would be 0x40 and the other 0x41.)
Adafruit_PWMServoDriver pca = Adafruit_PWMServoDriver(0x40);


// ============================================================
// SERVO SPEED/RANGE SETTINGS
// ============================================================
// Servo motors are controlled by sending them electrical pulses.
// The LENGTH of the pulse tells the servo what angle to go to.
// Think of it like blinking a flashlight:
//   - A short blink = move all the way left (0 degrees)
//   - A long blink = move all the way right (180 degrees)
//   - A medium blink = stay in the middle (90 degrees)
// We blink the signal 50 times every second - that's what servos expect.


// How many times per second the signal pulses (50 is the standard for servos)
#define SERVO_FREQ   50


// The shortest pulse length = servo goes to 0 degrees (full left)
// 500 means 500 microseconds (a microsecond is one millionth of a second)
#define SERVO_MIN_US 500


// The longest pulse length = servo goes to 180 degrees (full right)
// 2500 means 2500 microseconds
#define SERVO_MAX_US 2500


// ============================================================
// WHICH WIRE GOES TO WHICH SERVO
// ============================================================
// The PCA9685 chip has 16 output slots (numbered 0 to 15).
// Each slot connects to one servo motor with a wire.
// Here we give each slot a name so the code is easier to read.
// For example, instead of writing "0" to mean the lower joint,
// we write "CH_LOWER" - much easier to understand!


// Slot 0 on the chip = Lower Joint servo (the joint closest to the base)
// "inverted" means: when the slider on the web page goes UP, this servo goes DOWN
// This is done on purpose so the arm moves in a natural direction
#define CH_LOWER 0


// Slot 1 = Arm servo (the middle section of the arm that extends out)
#define CH_ARM   1


// Slot 2 = Claw servo (the gripper that opens and closes to grab things)
#define CH_CLAW  2


// Slot 3 = Base servo (rotates the whole arm left and right)
#define CH_BASE  3


// ============================================================
// WIFI NETWORK NAME AND PASSWORD
// ============================================================


// This is the name of the WiFi network the ESP32 will create.
// When you go to WiFi settings on your phone, you'll see "GearUp-Arm" in the list.
const char* AP_SSID = "GearUp-Arm";


// This is the password someone needs to type to join that WiFi network.
// Must be at least 8 characters long (that's a WiFi security rule).
const char* AP_PASS = "12345678";


// ============================================================
// SHARED VARIABLES - Things the whole program needs to remember
// ============================================================


// This creates the web server on port 80.
// Port 80 is the standard door that web browsers knock on by default.
// When you type "http://192.168.4.1" in a browser (no special port number),
// the browser automatically uses port 80.
WebServer server(80);


// This is a list of 4 numbers that remember the current angle of each servo.
// angles[0] = current angle of the Lower Joint
// angles[1] = current angle of the Arm
// angles[2] = current angle of the Claw
// angles[3] = current angle of the Base
// All start at 90 degrees, which is the middle/neutral position (pointing straight up).
int angles[4] = {90, 90, 90, 90};


// Logo served as /logo route
const uint8_t LOGO_DATA[] = {0xff, 0xd8, 0xff, 0xe0, 0x00, 0x10, 0x4a, 0x46, 0x49, 0x46, 0x00, 0x01, 0x01,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 0xff, 0xd9};
const int LOGO_LEN = 7253;


// ============================================================
// FUNCTION: Convert degrees into a number the servo chip understands
// ============================================================
// People think in degrees (0 to 180).
// But the PCA9685 chip doesn't understand degrees - it needs a number
// between 0 and 4095 that tells it how long to make the electrical pulse.
// This function does that conversion: you give it degrees, it gives back
// the right number for the chip.


uint16_t degreesToTicks(int deg) {


 // Safety check: make sure the angle is between 0 and 180.
 // If someone accidentally sends 200 degrees, this clamps it to 180.
 // If someone sends -5, this clamps it to 0.
 // This protects the servo from being commanded to an impossible position.
 deg = constrain(deg, 0, 180);


 // Step 1: Convert degrees to pulse length (in microseconds).
 // map() scales one range to another range. Here:
 //   0 degrees   → 500 microseconds  (shortest pulse = full left)
 //   90 degrees  → 1500 microseconds (medium pulse = middle)
 //   180 degrees → 2500 microseconds (longest pulse = full right)
 // Think of it like: map(input, input_min, input_max, output_min, output_max)
 int us = map(deg, 0, 180, SERVO_MIN_US, SERVO_MAX_US);


 // Step 2: Convert microseconds into a "tick" number for the PCA9685 chip.
 // The chip sends one full pulse every 20,000 microseconds (that's 50 per second).
 // It divides that 20,000 microsecond window into 4096 equal steps.
 // So: ticks = (how long our pulse is) / (total window) * (total steps)
 // Example for 90 degrees: 1500 / 20000 * 4096 = 307 ticks
 return (uint16_t)((us / 20000.0) * 4096);
}


// ============================================================
// FUNCTION: Move a servo to a specific angle
// ============================================================
// This is a helper function that makes moving a servo simple.
// You just tell it which servo (ch = 0, 1, 2, or 3) and what angle (0-180).
// It handles all the conversion math automatically by calling degreesToTicks().


void setServo(uint8_t ch, int deg) {
 // Tell the PCA9685 chip to move servo on channel "ch" to angle "deg".
 // The "0" means: start the pulse at the very beginning of each cycle.
 // degreesToTicks(deg) converts the angle into the number the chip needs.
 pca.setPWM(ch, 0, degreesToTicks(deg));
}


// ============================================================
// FUNCTIONS THAT RESPOND TO BROWSER REQUESTS
// ============================================================
// The web server listens for requests from browsers.
// When someone opens a URL, the server figures out which function to call.
// Below are three functions - one for each URL the server handles.


// FUNCTION: Send the control webpage
// When someone types http://192.168.4.1 into their browser, this runs.
// It sends the slider control page (from html.h) back to the browser.
void handleRoot() {
 // send_P sends data stored in program memory (a space-saving technique on microcontrollers).
 // 200 means "everything is OK" - it's a standard success code browsers understand.
 // "text/html" tells the browser "what I'm sending you is a webpage".
 // HTML is the variable (from html.h) that contains the actual webpage code.
 server.send_P(200, "text/html", HTML);
}


// FUNCTION: Send the team logo image
// When the webpage loads, it asks for the logo by visiting /logo.
// This function sends the image back so it appears on the control page.
// The logo image (a JPEG photo) is stored directly inside the code as a
// list of numbers (called bytes). This means we don't need a separate image file.
void handleLogo() {
 // 200 = success ("I found what you asked for")
 // "image/jpeg" = tells the browser "what I'm sending is a photo, not a webpage"
 // LOGO_DATA = the list of bytes that make up the image
 // LOGO_LEN = the total size of the image (7253 bytes = about 7 kilobytes)
 server.send_P(200, "image/jpeg", (const char*)LOGO_DATA, LOGO_LEN);
}


// FUNCTION: Move a servo when the user adjusts a slider
// This is the most important function - it's what actually makes the robot arm move.
// When you move a slider on the control page, the webpage sends a message like:
//   /set?servo=Base&angle=120
// That means: "move the Base servo to 120 degrees".
// This function reads that message and physically moves the correct servo.
void handleSet() {


 // Check that the message includes BOTH which servo to move AND what angle to go to.
 // If either piece of info is missing, we can't do anything - send back an error.
 // 400 means "Bad Request" - the browser sent an incomplete message.
 if (!server.hasArg("servo") || !server.hasArg("angle")) {
   server.send(400, "text/plain", "Bad request");
   return;
 }


 // Read which servo to move from the message.
 // Example: if the message was /set?servo=Base&angle=120, then name = "Base"
 String name = server.arg("servo");


 // Read the angle from the message and turn it from text into a number.
 // Also make sure it stays between 0 and 180 - those are the limits of a servo.
 // .toInt() converts the text "120" into the number 120.
 // constrain() keeps the value in a safe range (in case the browser sends something weird).
 int angle = constrain(server.arg("angle").toInt(), 0, 180);


 // Figure out which servo was requested and move it.
 // We also update the angles[] list so we always know each servo's current position.
 if      (name == "Base")  { angles[3]=angle; setServo(CH_BASE,  angle); }  // rotate base
 else if (name == "Lower") { angles[0]=angle; setServo(CH_LOWER, angle); }  // lower joint
 else if (name == "Arm")   { angles[1]=angle; setServo(CH_ARM,   angle); }  // arm extension
 else if (name == "Claw")  { angles[2]=angle; setServo(CH_CLAW,  angle); }  // claw grip
 else {
   // If the servo name doesn't match any of the above, something went wrong.
   // Send an error back to the browser.
   server.send(400, "text/plain", "Unknown servo");
   return;
 }


 // Print a message to the computer screen (Arduino Serial Monitor) for debugging.
 // Example output: [SET] Base -> 120 deg
 // This helps you see what's happening when you test the robot.
 Serial.printf("[SET] %s -> %d deg\n", name.c_str(), angle);


 // Tell the browser everything worked. "OK" is all we need to say.
 // The browser uses this to update the angle display on the control page.
 server.send(200, "text/plain", "OK");
}


// ============================================================
// SETUP - Runs ONCE when the ESP32 first turns on
// ============================================================
// This is like the "morning routine" of the program.
// It runs exactly once at startup and gets everything ready:
//   1. Starts the connection to your computer for debug messages
//   2. Wakes up the servo controller chip
//   3. Moves all servos to the center position (90 degrees)
//   4. Creates the WiFi network
//   5. Starts the web server


void setup() {


 // ---- Step 1: Enable debug messages ----
 // This opens a communication channel between the ESP32 and your computer
 // so that when you have Arduino IDE open, you can see messages in the Serial Monitor.
 // 115200 is the speed of that communication (how many bits travel per second).
 // It's just a standard speed - both sides need to use the same number.
 Serial.begin(115200);


 // Wait 400 milliseconds (less than half a second) before doing anything else.
 // This gives the Serial Monitor a moment to be ready, so we don't miss messages.
 delay(400);


 // Print a welcome message so we know the program started successfully.
 Serial.println("\n=== Gear Up 31242 Claw Master ===");


 // ---- Step 2: Connect to the servo controller chip ----
 // Wire.begin(21, 22) turns on the 2-wire communication system.
 // Pin 21 on the ESP32 carries data to and from the PCA9685 chip.
 // Pin 22 on the ESP32 sends a timing beat so both sides stay in sync.
 // Think of it like two people talking: one is the messenger (pin 21),
 // and the other taps a rhythm to keep things orderly (pin 22).
 Wire.begin(21, 22);


 // Wake up the PCA9685 servo controller chip.
 // Before this line, the chip is "asleep" and won't respond to commands.
 pca.begin();


 // Tell the chip how fast its internal clock runs (27 million beats per second).
 // The chip uses this to calculate the exact timing of pulses it sends to servos.
 // This specific number was measured for our chip model to make angles accurate.
 pca.setOscillatorFrequency(27000000);


 // Tell the chip to send 50 pulses per second to the servos.
 // This is the standard speed that all hobby servo motors expect.
 // If you set this too fast or too slow, the servos won't move correctly.
 pca.setPWMFreq(SERVO_FREQ);


 // Wait 100 milliseconds for the chip to fully start up before we use it.
 delay(100);


 // ---- Step 3: Move all 4 servos to the center (neutral) position ----
 // This loop goes through servo slots 0, 1, 2, 3 and sets each to 90 degrees.
 // ch++ means "add 1 to ch each loop" so it counts: 0, 1, 2, 3.
 // Starting at center prevents the arm from jumping to a random position on startup.
 for (int ch = 0; ch < 4; ch++) setServo(ch, 90);


 Serial.println("[PCA9685] All 4 servos -> 90 deg");


 // ---- Step 4: Create the WiFi network ----
 // Tell the ESP32 to work in "Access Point" mode.
 // This means it creates its OWN WiFi network instead of joining an existing one.
 // (Like turning your phone into a hotspot instead of connecting to your home WiFi.)
 WiFi.mode(WIFI_AP);


 // Actually create the WiFi network using the name and password we set earlier.
 WiFi.softAP(AP_SSID, AP_PASS);


 // Print the WiFi details to the Serial Monitor so you know how to connect.
 Serial.printf("[WiFi] SSID: %s | Pass: %s\n", AP_SSID, AP_PASS);


 // Print the address to type in the browser.
 // softAPIP() gets the ESP32's address on the network it just created.
 // toString() converts that address into readable text like "192.168.4.1".
 Serial.printf("[WiFi] Go to: http://%s\n", WiFi.softAPIP().toString().c_str());


 // ---- Step 5: Set up and start the web server ----
 // Tell the server: "when someone visits '/', run handleRoot()"
 server.on("/", handleRoot);


 // Tell the server: "when someone visits '/logo', run handleLogo()"
 server.on("/logo", handleLogo);


 // Tell the server: "when someone visits '/set', run handleSet()"
 server.on("/set", handleSet);


 // Start the server. From this point on, it listens for browser requests.
 server.begin();


 Serial.println("[Server] Ready!");
 // Setup is done! The robot arm is ready to be controlled.
}


// ============================================================
// LOOP - Runs over and over forever after setup() finishes
// ============================================================
// In Arduino programming, there are always two main functions:
//   setup() - runs once at the start (we just wrote that above)
//   loop()  - runs forever in a cycle (this one below)
//
// Our loop is very simple: just keep checking if any browser has sent a message.
// If someone moved a slider, there will be a message waiting.
// handleClient() picks it up and calls the right function (like handleSet).
// If there's no message, it does nothing and immediately checks again.
// This repeats thousands of times per second, so the arm responds almost instantly.


void loop() {
 server.handleClient();
}


// ============================================================
// FULL PICTURE: How everything connects together
// ============================================================
// Here's the complete story of how this robot arm works, from power-on to movement:
//
// 1. You plug in the ESP32. setup() runs.
//    - All 4 servos move to 90 degrees (center/neutral position).
//    - A WiFi network called "GearUp-Arm" appears on nearby devices.
//    - The web server starts waiting for visitors.
//
// 2. You connect your phone or laptop to "GearUp-Arm" WiFi (password: 12345678).
//
// 3. You open a browser and go to http://192.168.4.1
//    - The ESP32 receives that visit and runs handleRoot().
//    - handleRoot() sends back the HTML control page (from html.h).
//    - Your browser displays a page with 4 sliders and the team logo.
//
// 4. The browser also requests the logo image at /logo.
//    - handleLogo() sends the JPEG image data back.
//    - The logo appears on the control page.
//
// 5. You drag a slider (say, Base Rotation to 120 degrees).
//    - The JavaScript in the webpage sends a request to: /set?servo=Base&angle=120
//    - handleSet() receives this, reads "Base" and "120".
//    - It calls setServo(CH_BASE, 120).
//    - setServo() calls degreesToTicks(120) to convert 120 degrees to a tick number.
//    - It sends that tick number to the PCA9685 chip via the 2-wire connection.
//    - The PCA9685 creates the right electrical pulse and sends it down the wire to the servo.
//    - The servo motor physically rotates to 120 degrees. The arm moves!
//    - handleSet() sends "OK" back to the browser.
//    - The browser shows "Base → 120°" in the status bar.
//
// 6. loop() keeps running, checking for the next slider move.


// ============================================================
// ABOUT THE CONTROL WEBPAGE (html.h)
// ============================================================
// The webpage is built with three web languages:
//
// HTML - the structure (creates the cards, sliders, buttons, and text labels)
// CSS  - the styling (makes it look good: dark theme, gold color scheme, fonts)
// JavaScript - the behavior (makes sliders interactive and sends messages to ESP32)
//
// What the page shows:
//   - A top bar with the team logo and name
//   - 4 control cards, one per servo:
//       BASE         - rotates the whole arm left/right
//       LOWER JOINT  - moves the bottom part of the arm up/down
//                      (note: its slider is reversed so the arm moves naturally)
//       ARM          - extends or retracts the middle arm section
//       CLAW         - opens or closes the gripper
//   - Each card has a slider (0-180), a big angle number, and degree tick marks
//   - A "Center All" button at the bottom that snaps all servos back to 90 degrees
//   - A status bar that shows the last move made, or a warning if WiFi is lost
//
// The three JavaScript functions doing the work:
//   mv(name, value) - called while you drag the slider - just updates the number display
//   snd(name, value) - called when you release the slider - sends the /set request to ESP32
//   ca()            - called when "Center All" is pressed - resets all 4 sliders to 90



